
// Working of All alphabets..
int layer_speed=500;
int latchPin=13;
//int count=0;
int level=7;
int clockPin=12;
int dataPin=11;
int mosfet[8]={10,9,8,7,6,5,4,3};
bool present[8][8]={{1,1,1,1,1,1,1,1},{1,1,1,1,1,1,1,1},{1,1,1,1,1,1,1,1},{1,1,1,1,1,1,1,1},{1,1,1,1,1,1,1,1},{1,1,1,1,1,1,1,1},{1,1,1,1,1,1,1,1},{1,1,1,1,1,1,1,1}};

bool a[26][8][8]={
              {{1,0,1,1,1,1,0,1},{1,0,1,1,1,1,0,1},{1,0,0,0,0,0,0,1},{1,0,1,1,1,1,0,1},{1,1,0,1,1,0,1,1},{1,1,1,0,0,1,1,1},{1,1,1,1,1,1,1,1},{1,0,1,1,1,1,0,1}},
              {{1,0,1,1,1,0,1,1},{1,0,1,1,1,0,1,1},{1,0,0,0,0,1,1,1},{1,0,1,1,1,0,1,1},{1,0,1,1,1,0,1,1},{1,0,0,0,0,1,1,1},{1,1,1,1,1,1,1,1},{1,0,0,0,0,1,1,1}},
              {{1,1,0,1,1,1,1,1},{1,0,1,1,1,1,1,1},{1,0,1,1,1,1,1,1},{1,0,1,1,1,1,1,1},{1,0,1,1,1,1,1,1},{1,1,0,1,1,1,1,1},{1,1,1,0,0,0,0,1},{1,1,1,0,0,0,0,1}},
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              {{1,0,1,1,1,1,1,1},{1,1,0,1,1,1,1,1},{1,1,1,0,1,1,1,1},{1,1,1,1,0,1,1,1},{1,1,1,1,1,0,1,1},{1,1,1,1,1,1,0,1},{0,0,0,0,0,0,0,0},{0,0,0,0,0,0,0,0}}
             }


void controlmosfet(int current){
  for(int foo=0;foo<8;foo++){
    digitalWrite(mosfet[foo],LOW);
  }
  digitalWrite(mosfet[current],HIGH);
}


void displayleds(int m,int level,int letter){
  letter -= 65;
  for(int temp=0;temp<8;temp++){
    present[level][temp]=a[letter][m][temp]; 
  }
  //digitalWrite(latchPin,LOW);
  updateShiftRegister();
  //digitalWrite(latchPin,HIGH);
  
  for(int temp=0;temp<8;temp++){
    present[level][temp]=1;
  }
  
  
}

void updateShiftRegister(){
  for(int i=0;i<8;i++){
    for (int j=0;j<8;j++){
      digitalWrite(clockPin,LOW);
      digitalWrite(dataPin,present[i][j]);
      digitalWrite(clockPin,HIGH);
    }
  }
}

void setup() {
  Serial.begin(9600);
  pinMode(latchPin,OUTPUT);
  pinMode(clockPin,OUTPUT);
  pinMode(dataPin,OUTPUT);
  for(int i=0;i<8;i++){
    pinMode(mosfet[i],OUTPUT);
  }
  // put your setup code here, to run once:

}

char serialListener;
char serialListener_temp;
void loop() {
  
  //char serialListener=32;
  //char serialListener_temp;
  if(Serial.available()>0){
      serialListener_temp=Serial.read();
      if((serialListener_temp>=65 && serialListener_temp<=90)) ||  || {
        serialListener = serialListener_temp; }
      else if (serialListener_temp>=97 && serialListener_temp<=122){
        serialListener = serialListener_temp - 32; }
      else if (serialListener_temp==32){
      }
       
  //level=7-((int(count/(speed_cube)))%8);
  for(level=7;level>=0;level--){
    for(int m=0;m<8;m++){
      digitalWrite(latchPin,LOW);
      controlmosfet(m);
      displayleds(m,level,serialListener);
      delay(1);
      digitalWrite(latchPin,HIGH);
    }
    delay(layer_speed);
  }
  
  
  }
  
  //count=count+1;
  // put your main code here, to run repeatedly:

}
